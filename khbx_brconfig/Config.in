## khbx_brconfig/Config.in
```kconfig
source "$BR2_EXTERNAL_KHBX_PATH/package/foobar_module/Config.in"
source "$BR2_EXTERNAL_KHBX_PATH/package/foobar_chrdev/Config.in"
```

## khbx_brconfig/package/foobar_chrdev/Config.in
```kconfig
config BR2_PACKAGE_FOOBAR_CHRDEV
	bool "KHBX character device driver test"
	help
	  Kernel module to foo the bar.
```

## khbx_brconfig/package/foobar_module/Config.in
```kconfig
config BR2_PACKAGE_FOOBAR_MODULE
	bool "Foobar dummy test module"
	help
	  Kernel module to foo the bar.
```
